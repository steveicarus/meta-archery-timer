## conf/distro/archery-timer.conf
```bitbake
require conf/distro/poky.conf

DISTRO = "archery-timer"
DISTROOVERRIDES = "poky:archery-timer"
DISTRO_NAME = "Archery Timer (embedded)"
DISTRO_VERSION = "0.0.0"

INIT_MANAGER = "systemd"

MAINTAINER = "Steve Williams <steve@icarus.com>"

LOCALCONF_VERSION = "2"
```

## conf/layer.conf
```bitbake
# We have a conf and classes directory, add to BBPATH
BBPATH .= ":${LAYERDIR}"

# We have recipes-* directories, add to BBFILES
BBFILES += "${LAYERDIR}/recipes-*/*/*.bb \
            ${LAYERDIR}/recipes-*/*/*.bbappend"

BBFILE_COLLECTIONS += "meta-archery-timer"
BBFILE_PATTERN_meta-archery-timer = "^${LAYERDIR}/"
BBFILE_PRIORITY_meta-archery-timer = "6"

LAYERDEPENDS_meta-archery-timer = "core"
LAYERSERIES_COMPAT_meta-archery-timer = "scarthgap"
```

## conf/machine/rpi-archery-timer.conf
```bitbake
#@TYPE: Machine
#@NAME: RaspberryPi 4 based Archery Timer Gadget
#@DESCRIPTION: Machine configuration for the Archery Timer Gadget

require conf/machine/raspberrypi4-64.conf

MACHINEOVERRIDES =. "rpi-archery-timer:"

# Raspberry Pi configuration
BOOT_SPACE = "98304"
ENABLE_UART = "1"
IMAGE_FSTYPES = "tar.xz ext3 rpi-sdimg"
BOOTDD_VOLUME_ID = "archerytime"

# This is needed for WiFi module firmware.
LICENSE_FLAGS_ACCEPTED += " synaptics-killswitch"
```
